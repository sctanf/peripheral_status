## boards/arm/slimevrmini_p2_uf2/Kconfig.defconfig
```kconfig
# Copyright (c) 2024 Nordic Semiconductor ASA
# SPDX-License-Identifier: Apache-2.0

if BOARD_SLIMEVRMINI_P2_UF2

config BOARD
	default "slimevrmini_p2_uf2"

config BT_CTLR
   default BT


endif
```
